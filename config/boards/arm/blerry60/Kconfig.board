## config/boards/arm/blerry60/Kconfig.board
```kconfig
# BLErry60 board configuration

# Copyright (c) 2020 The ZMK Contributors
# SPDX-License-Identifier: MIT

config BOARD_BLERRY60
	bool "BLErry60"
	depends on SOC_NRF52840_QIAA
```

## config/boards/arm/blerry65/Kconfig.board
```kconfig
# BLErry65 board configuration

# Copyright (c) 2020 The ZMK Contributors
# SPDX-License-Identifier: MIT

config BOARD_BLERRY65
	bool "BLErry65"
	depends on SOC_NRF52840_QIAA
```

## config/boards/arm/blerry75/Kconfig.txt
```kconfig
# BLErry75 board configuration

# Copyright (c) 2020 The ZMK Contributors
# SPDX-License-Identifier: MIT

config BOARD_BLERRY75
	bool "BLErry75"
	depends on SOC_NRF52840_QIAA
```
